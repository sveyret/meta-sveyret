## meta-core/conf/layer.conf
```bitbake
# We have a conf and classes directory, add to BBPATH
BBPATH .= ":${LAYERDIR}"

# We have recipes-* directories, add to BBFILES
BBFILES += "${LAYERDIR}/recipes-*/*/*.bb \
            ${LAYERDIR}/recipes-*/*/*.bbappend"

BBFILE_COLLECTIONS += "sveyret-core"
BBFILE_PATTERN_sveyret-core = "^${LAYERDIR}/"
BBFILE_PRIORITY_sveyret-core = "6"

LAYERDEPENDS_sveyret-core = "core"
LAYERSERIES_COMPAT_sveyret-core = "styhead"
```

## meta-java-apps/conf/layer.conf
```bitbake
# We have a conf and classes directory, add to BBPATH
BBPATH .= ":${LAYERDIR}"

# We have recipes-* directories, add to BBFILES
BBFILES += "${LAYERDIR}/recipes-*/*/*.bb \
            ${LAYERDIR}/recipes-*/*/*.bbappend"

BBFILE_COLLECTIONS += "sveyret-java-apps"
BBFILE_PATTERN_sveyret-java-apps = "^${LAYERDIR}/"
BBFILE_PRIORITY_sveyret-java-apps = "6"

LAYERDEPENDS_sveyret-java-apps = "core"
LAYERSERIES_COMPAT_sveyret-java-apps = "styhead"
```
